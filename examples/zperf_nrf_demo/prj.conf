## CMakeLists.txt
```
cmake_minimum_required(VERSION 3.20.0)

list(APPEND ZEPHYR_EXTRA_MODULES "${CMAKE_CURRENT_LIST_DIR}/../..")

find_package(Zephyr REQUIRED HINTS $ENV{ZEPHYR_BASE})

project(ZPerf_nRF52DK_Demo)

set(ZPERF_NRF_DEMO_APP_DIR "${CMAKE_CURRENT_LIST_DIR}")
include("${CMAKE_CURRENT_LIST_DIR}/cmake/app_sources.cmake")
```

## sample.yaml
```
# SPDX-License-Identifier: Apache-2.0

sample:
  name: zperf nRF52 demo
  description: zperf with BLE, LED and power management tasks on the nRF52 DK

common:
  tags: zperf
  build_only: true
  platform_allow:
    - nrf52dk/nrf52832
  integration_platforms:
    - nrf52dk/nrf52832

tests:
  zperf.nrf_demo: {}
```

## prj.conf
```kconfig
# Enable to use GPIO
CONFIG_GPIO=y

# Enable to use Power Management
CONFIG_PM=y
CONFIG_PM_STATS=y
CONFIG_PM_POLICY_CUSTOM=y
# CONFIG_PM_POLICY_CUSTOM=y

# Enable zperf module
CONFIG_ZPERF=y
# Enable tracing Tasks stat & CPU load
CONFIG_ZPERF_TRACE_MAIN_STAT=y
# Enable tracing CPU load string
CONFIG_ZPERF_TRACE_CPU_LOAD=y
# Enable tracing history
CONFIG_ZPERF_TRACE_HISTORY=y

# Enable to use STDOUT
CONFIG_STDOUT_CONSOLE=y

# Enable to use thread names
CONFIG_THREAD_NAME=y
CONFIG_SCHED_CPU_MASK=y

# Enable to use thread analyzer
# CONFIG_THREAD_ANALYZER=y
# CONFIG_THREAD_ANALYZER_USE_PRINTK=y
# CONFIG_THREAD_ANALYZER_AUTO=y

# Enable trace-hooks (zperf needs TRACING_USER, so other tracing formats like SystemView
# can't be enabled at the same time)
CONFIG_TRACING=y
CONFIG_TRACING_USER=y

# Enable to use get system uptime in system ticks
# CONFIG_SYS_CLOCK_TICKS_PER_SEC=

# Enable iterate over all the threads in the system
CONFIG_THREAD_MONITOR=y

# Enable to use logging (logging/log.h)
CONFIG_LOG=y
CONFIG_LOG_BUFFER_SIZE=10240
# Enable to read logs over SEGGER RTT (in addition to UART)
CONFIG_USE_SEGGER_RTT=y

# Enable to use BLE
CONFIG_BT=y
CONFIG_BT_SMP=y
CONFIG_BT_PERIPHERAL=y
CONFIG_BT_DEVICE_NAME="Zperf Demo"
CONFIG_BT_DIS=y
CONFIG_BT_DIS_PNP=n
CONFIG_BT_BAS=y
CONFIG_BT_HRS=y
CONFIG_BT_DEVICE_APPEARANCE=833
```

## src/main.c
```c
/**
 * @file   main.c
 * @brief  Contain implementation of main function.
 * @author nullsych
 * @date   May 7, 2024
 *
 */

#include <stdio.h>
#include <zephyr/kernel.h>

/* Application headers */
#include "common/Leds/Leds.h"
#include "common/TasksCfg.h"
#include "common/TasksApi.h"

/* Tool global API */
#include <zperf.h>

/* Rest of unmapped Zephyr hooks */
#include "RTOSHooks.h"

/* Power Management */
#include "PwrMgt/PwrMgt.h"

#include <zephyr/logging/log.h>
LOG_MODULE_REGISTER(main, LOG_LEVEL_DBG);

int main(void)
{
	zperf_pre_scheduler_init();

	PwrMgt_init();
	PwrMgt_traceResetReason();

	zperf_post_scheduler_init();
}

/* EOF */
```

## src/BleTask.c
```c
/**
 * @file   BleTask.c
 * @brief  Contain main implementation for BleTask.
 * @author nullsych
 * @date   May 6, 2024
 *
 * The application exposes the Bluetooth Battery Service (BAS). Connected BLE clients can read the
 * Battery Level characteristic, which reports a simulated (!) battery percentage updated
 * periodically.
 */

#include <zephyr/types.h>
#include <stddef.h>
#include <zephyr/sys/util.h>

#include <zephyr/bluetooth/bluetooth.h>
#include <zephyr/bluetooth/hci.h>
#include <zephyr/bluetooth/conn.h>
#include <zephyr/bluetooth/uuid.h>
#include <zephyr/bluetooth/gatt.h>
#include <zephyr/bluetooth/services/bas.h>

#include "common/TasksApi.h"
#include "common/TasksCfg.h"
#include "common/ErrorCodes.h"

#include <zephyr/logging/log.h>
LOG_MODULE_REGISTER(BleTask, LOG_LEVEL_DBG);

TASK_LOCAL const struct bt_data Ble_advertisingData[] = {
	BT_DATA_BYTES(BT_DATA_FLAGS, (BT_LE_AD_GENERAL | BT_LE_AD_NO_BREDR)),
	BT_DATA_BYTES(BT_DATA_UUID16_ALL, BT_UUID_16_ENCODE(BT_UUID_BAS_VAL),
		      BT_UUID_16_ENCODE(BT_UUID_DIS_VAL))};

TASK_LOCAL const struct bt_data Ble_scanResponseData[] = {
	BT_DATA(BT_DATA_NAME_COMPLETE, CONFIG_BT_DEVICE_NAME, sizeof(CONFIG_BT_DEVICE_NAME) - 1),
};

TASK_LOCAL void Ble_connected(struct bt_conn *conn, uint8_t errCode)
{
	if (errCode) {
		LOG_ERR("Connection failed, errCode=0x%02x", errCode);
	} else {
		LOG_INF("Client connected!");
	}
}

TASK_LOCAL void Ble_disconnected(struct bt_conn *conn, uint8_t reason)
{
	LOG_INF("Client disconnected, reason=0x%02x", reason);
}

TASK_LOCAL void Ble_authCancel(struct bt_conn *conn)
{
	char bleAddress[BT_ADDR_LE_STR_LEN];

	bt_addr_le_to_str(bt_conn_get_dst(conn), bleAddress, sizeof(bleAddress));

	LOG_INF("Pairing cancelled: %s", bleAddress);
}

TASK_LOCAL void Ble_notifyBatteryLevel(void)
{
	uint8_t batteryLevel = bt_bas_get_battery_level();

	batteryLevel--;

	if (!batteryLevel) {
		batteryLevel = 100U;
	}

	bt_bas_set_battery_level(batteryLevel);
}

BT_CONN_CB_DEFINE(conn_callbacks) = {
	.connected = Ble_connected,
	.disconnected = Ble_disconnected,
};

TASK_LOCAL struct bt_conn_auth_cb Ble_authenticatedCallback = {
	.cancel = Ble_authCancel,
};

TASK_LOCAL int Ble_ready(void)
{
	int errCode;

	LOG_INF("Begin advertising...");

	errCode = bt_le_adv_start(BT_LE_ADV_PARAM(BT_LE_ADV_OPT_CONN, BT_GAP_ADV_FAST_INT_MIN_2,
						  BT_GAP_ADV_FAST_INT_MAX_2, NULL),
				  Ble_advertisingData, ARRAY_SIZE(Ble_advertisingData),
				  Ble_scanResponseData, ARRAY_SIZE(Ble_scanResponseData));
	if (errCode) {
		LOG_ERR("Advertising failed to start, errCode=%d", errCode);
		return errCode;
	}

	LOG_INF("Advertising successfully started!");
	return errCode;
}

TASK_LOCAL void Ble_main(void)
{
	int errCode;

	errCode = bt_enable(NULL);

	if (errCode) {
		LOG_ERR("Bluetooth initialization failed, errCode=%d", errCode);
	}

	errCode = Ble_ready();
	if (errCode) {
		LOG_ERR("Bluetooth not ready, errCode=%d", errCode);
	}

	errCode = bt_conn_auth_cb_register(&Ble_authenticatedCallback);
	if (errCode) {
		LOG_ERR("Authenticated callback register failed, errCode=%d", errCode);
	}

	for (;;) {
		k_msleep(LED_TASK_PERIOD);

		/* Battery level simulation */
		Ble_notifyBatteryLevel();
	}
}

TASK_LOCAL TASK_ENTRY_POINT void Task_BLE_entry(void)
{
	Ble_main();
}

/* Define the thread using a macro */
K_THREAD_DEFINE(Task_BLE, BLE_TASK_STACKSIZE, Task_BLE_entry, NULL, NULL, NULL, BLE_TASK_PRIORITY,
		0, 0);

/* EOF */
```

## src/LedTask.c
```c
/**
 * @file   LedTask.c
 * @brief  Contain main implementation for LedTask.
 * @author nullsych
 * @date   May 6, 2024
 *
 */

#include <zephyr/kernel.h>
#include <zephyr/debug/thread_analyzer.h>
#include <zephyr/tracing/tracing.h>

#include "common/TasksApi.h"
#include "common/TasksCfg.h"
#include "common/Leds/Leds.h"

#include <zephyr/logging/log.h>
LOG_MODULE_REGISTER(LedTask, LOG_LEVEL_DBG);

TASK_LOCAL TASK_ENTRY_POINT void Task_LED_entry(void)
{
	Leds_init();

	for (;;) {
		Leds_toggleLeds(LED_TASK_PERIOD);
	}
}

/* Define the thread using a macro */
K_THREAD_DEFINE(Task_LED, LED_TASK_STACKSIZE, Task_LED_entry, NULL, NULL, NULL, LED_TASK_PRIORITY,
		0, 0);

/* EOF */
```

## src/RTOSHooks.h
```c
/**
 * @file   main.c
 * @brief  Contain implementation of OS-specific hook routines.
 *         Serves as build mock for West, the real magic is in tool.
 * @author nullsych
 * @date   May 7, 2024
 *
 */

#include <zephyr/kernel.h>

void sys_trace_thread_abort_user(struct k_thread *thread)
{
	/* code */
}

void sys_trace_thread_suspend_user(struct k_thread *thread)
{
	/* code */
}

void sys_trace_thread_resume_user(struct k_thread *thread)
{
	/* code */
}

void sys_trace_thread_name_set_user(struct k_thread *thread)
{
	/* code */
}

void sys_trace_thread_info_user(struct k_thread *thread)
{
	/* code */
}

void sys_trace_thread_sched_ready_user(struct k_thread *thread)
{
	/* code */
}

void sys_trace_thread_pend_user(struct k_thread *thread)
{
	/* code */
}

void sys_trace_thread_priority_set_user(struct k_thread *thread, int prio)
{
	/* code */
}

void sys_trace_thread_create_user(struct k_thread *thread)
{
	/* code */
}
```

## src/ZPerfTask.c
```c
/**
 * @file   ZPerfTask.c
 * @author nullsych
 * @date   May 7, 2024
 */

#include <zephyr/kernel.h>
#include <zperf.h>

#include "common/TasksApi.h"
#include "common/TasksCfg.h"

#include <zephyr/logging/log.h>
LOG_MODULE_REGISTER(NrfPerfTask, LOG_LEVEL_DBG);

TASK_LOCAL TASK_ENTRY_POINT void task_zperf_entry(void)
{
	for (;;) {
		zperf_runtime_overall_statistic();
		k_msleep(ZPERF_TASK_PERIOD);
	}
}

/* Define the thread using a macro */
K_THREAD_DEFINE(Task_ZPerf, ZPERF_TASK_STACKSIZE, task_zperf_entry, NULL, NULL, NULL,
		ZPERF_TASK_PRIORITY, 0, 0);
```
