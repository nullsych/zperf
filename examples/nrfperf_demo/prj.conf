## CMakeLists.txt
```
cmake_minimum_required(VERSION 3.20.0)

list(APPEND ZEPHYR_EXTRA_MODULES "${CMAKE_CURRENT_LIST_DIR}/../..")

find_package(Zephyr REQUIRED HINTS $ENV{ZEPHYR_BASE})

project(NrfNrfPerfDemo)

set(NRF_PERF_DEMO_APP_DIR "${CMAKE_CURRENT_LIST_DIR}")
include("${CMAKE_CURRENT_LIST_DIR}/cmake/app_sources.cmake")
```

## prj.conf
```kconfig
# Enable to use GPIO
CONFIG_GPIO=y

# Enable to use Power Management
CONFIG_PM=y
CONFIG_PM_STATS=y
CONFIG_PM_POLICY_CUSTOM=y
# CONFIG_PM_POLICY_CUSTOM=y

# Enable nrf_perf module
CONFIG_NRF_PERF=y
CONFIG_NRF_PERF_USER_TASKS_COUNT=3
CONFIG_NRF_PERF_SYSTEM_TASKS_COUNT=5
CONFIG_NRF_PERF_TRACE_MAIN_STAT=y
CONFIG_NRF_PERF_TRACE_UPTIME=y
CONFIG_NRF_PERF_TRACE_CPU_LOAD=y
CONFIG_NRF_PERF_TRACE_HISTORY=n

# Enable to use STDOUT
CONFIG_STDOUT_CONSOLE=y

# Enable to use thread names
CONFIG_THREAD_NAME=y
CONFIG_SCHED_CPU_MASK=y

# Enable to use thread analyzer
# CONFIG_THREAD_ANALYZER=y
# CONFIG_THREAD_ANALYZER_USE_PRINTK=y
# CONFIG_THREAD_ANALYZER_AUTO=y

# Enable to use SEGGER SystemView
CONFIG_SEGGER_SYSTEMVIEW=y
CONFIG_USE_SEGGER_RTT=y

# Enable for post-mortem tracing
CONFIG_SEGGER_SYSVIEW_POST_MORTEM_MODE=n

# Enable trace-hooks
CONFIG_TRACING=y
CONFIG_TRACING_USER=y

# Enable to use get system uptime in system ticks
# CONFIG_SYS_CLOCK_TICKS_PER_SEC=

# Enable to use custom data in threads
CONFIG_THREAD_CUSTOM_DATA=y
# Enable iterate over all the threads in the system
CONFIG_THREAD_MONITOR=y

# Enable to use logging (logging/log.h)
CONFIG_LOG=y
CONFIG_LOG_BUFFER_SIZE=10240

# Enable to use BLE
CONFIG_BT=y
CONFIG_BT_SMP=y
CONFIG_BT_PERIPHERAL=y
CONFIG_BT_DEVICE_NAME="Nrf nrf_perf"
CONFIG_BT_DIS=y
CONFIG_BT_DIS_PNP=n
CONFIG_BT_BAS=y
CONFIG_BT_HRS=y
CONFIG_BT_DEVICE_APPEARANCE=833
```

## src/main.c
```c
/**
 * @file   main.c
 * @brief  Contain implementation of main function.
 * @author nullsych
 * @date   May 7, 2024
 *
 */

#include <stdio.h>
#include <zephyr/kernel.h>

/* Application headers */
#include "common/Leds/Leds.h"
#include "common/TasksCfg.h"
#include "common/TasksApi.h"

/* Tool global API */
#include <nrf_perf.h>

/* Rest of unmapped Zephyr hooks */
#include "RTOSHooks.h"

/* Power Management */
#include "PwrMgt/PwrMgt.h"

#include <zephyr/logging/log.h>
LOG_MODULE_REGISTER(main, LOG_LEVEL_DBG);

int main(void)
{
	nrf_perf_pre_scheduler_init();

	PwrMgt_init();
	PwrMgt_traceResetReason();

	nrf_perf_post_scheduler_init();
}

/* EOF */
```

## src/BleTask.c
```c
/**
 * @file   BleTask.c
 * @brief  Contain main implementation for BleTask.
 * @author nullsych
 * @date   May 6, 2024
 *
 * The application in the task specifically exposes the BAS (Battery Service) GATT Service.
 * Once a device connects it will read battery level value and return the percentage of battery level.
 */

#include <zephyr/types.h>
#include <stddef.h>
#include <zephyr/sys/util.h>

#include <zephyr/bluetooth/bluetooth.h>
#include <zephyr/bluetooth/hci.h>
#include <zephyr/bluetooth/conn.h>
#include <zephyr/bluetooth/uuid.h>
#include <zephyr/bluetooth/gatt.h>
#include <zephyr/bluetooth/services/bas.h>

#include "common/TasksApi.h"
#include "common/TasksCfg.h"
#include "common/ErrorCodes.h"

#include <zephyr/logging/log.h>
LOG_MODULE_REGISTER(BleTask, LOG_LEVEL_DBG);

TASK_LOCAL const struct bt_data Ble_advertisingData[] =
{
    BT_DATA_BYTES(BT_DATA_FLAGS, (BT_LE_AD_GENERAL | BT_LE_AD_NO_BREDR)),
    BT_DATA_BYTES(BT_DATA_UUID16_ALL,
    BT_UUID_16_ENCODE(BT_UUID_BAS_VAL),
    BT_UUID_16_ENCODE(BT_UUID_DIS_VAL))
};

TASK_LOCAL const struct bt_data Ble_scanResponseData[] =
{
    BT_DATA(BT_DATA_NAME_COMPLETE, CONFIG_BT_DEVICE_NAME, sizeof(CONFIG_BT_DEVICE_NAME) - 1),
};

TASK_LOCAL void Ble_connected(struct bt_conn *conn, uint8_t errCode)
{
    if (errCode)
    {
        LOG_ERR("Connection failed, errCode=0x%02x", errCode);
    }
    else
    {
        LOG_INF("Client connected!");
    }
}

TASK_LOCAL void Ble_disconnected(struct bt_conn *conn, uint8_t reason)
{
    LOG_INF("Client disconnected, reason=0x%02x", reason);
}

TASK_LOCAL void Ble_authCancel(struct bt_conn *conn)
{
    char bleAddress[BT_ADDR_LE_STR_LEN];

    bt_addr_le_to_str(bt_conn_get_dst(conn), bleAddress, sizeof(bleAddress));

    LOG_INF("Pairing cancelled: %s", bleAddress);
}

TASK_LOCAL void Ble_notifyBatteryLevel(void)
{
    uint8_t batteryLevel = bt_bas_get_battery_level();

    batteryLevel--;

    if (!batteryLevel)
    {
        batteryLevel = 100U;
    }

    bt_bas_set_battery_level(batteryLevel);
}

BT_CONN_CB_DEFINE(conn_callbacks) = {
    .connected = Ble_connected,
    .disconnected = Ble_disconnected,
};

TASK_LOCAL struct bt_conn_auth_cb Ble_authenticatedCallback = {
    .cancel = Ble_authCancel,
};

TASK_LOCAL int Ble_ready(void)
{
    int errCode;

    LOG_INF("Begin advertising...");

    errCode = bt_le_adv_start(
        BT_LE_ADV_PARAM(BT_LE_ADV_OPT_CONN, BT_GAP_ADV_FAST_INT_MIN_2, BT_GAP_ADV_FAST_INT_MAX_2, NULL),
        Ble_advertisingData, ARRAY_SIZE(Ble_advertisingData),
        Ble_scanResponseData, ARRAY_SIZE(Ble_scanResponseData));
    if (errCode)
    {
        LOG_ERR("Advertising failed to start, errCode=%d", errCode);
        return errCode;
    }

    LOG_INF("Advertising successfully started!");
    return errCode;
}

TASK_LOCAL void Ble_main(void)
{
    int errCode;

    errCode = bt_enable(NULL);

    if (errCode)
    {
        LOG_ERR("Bluetooth initialization failed, errCode=%d", errCode);
    }

    errCode = Ble_ready();
    if (errCode)
    {
        LOG_ERR("Bluetooth not ready, errCode=%d", errCode);
    }

    errCode = bt_conn_auth_cb_register(&Ble_authenticatedCallback);
    if (errCode)
    {
        LOG_ERR("Authenticated callback register failed, errCode=%d", errCode);
    }

    for (;;)
    {
        k_msleep(LED_TASK_PERIOD);

        /* Battery level simulation */
        Ble_notifyBatteryLevel();
    }
}

TASK_LOCAL TASK_ENTRY_POINT void Task_BLE_entry(void)
{
    Ble_main();
}

/* Define the thread using a macro */
K_THREAD_DEFINE(Task_BLE, BLE_TASK_STACKSIZE, Task_BLE_entry, NULL, NULL, NULL,
                BLE_TASK_PRIORITY, 0, 0);

/* EOF */
```

## src/LedTask.c
```c
/**
 * @file   LedTask.c
 * @brief  Contain main implementation for LedTask.
 * @author nullsych
 * @date   May 6, 2024
 *
 */

#include <zephyr/kernel.h>
#include <zephyr/debug/thread_analyzer.h>
#include <zephyr/tracing/tracing.h>

#include "common/TasksApi.h"
#include "common/TasksCfg.h"
#include "common/Leds/Leds.h"

#include <zephyr/logging/log.h>
LOG_MODULE_REGISTER(LedTask, LOG_LEVEL_DBG);

TASK_LOCAL TASK_ENTRY_POINT void Task_LED_entry(void)
{
   Leds_init();

   for (;;)
   {
      Leds_toggleLeds(LED_TASK_PERIOD);
   }
}

/* Define the thread using a macro */
K_THREAD_DEFINE(Task_LED, LED_TASK_STACKSIZE, Task_LED_entry, NULL, NULL, NULL,
                LED_TASK_PRIORITY, 0, 0);

/* EOF */
```

## src/RTOSHooks.h
```c
/**
 * @file   main.c
 * @brief  Contain implementation of OS-specific hook routines.
 *         Serves as build mock for West, the real magic is in library.
 * @author nullsych
 * @date   May 7, 2024
 *
 */

#include <zephyr/kernel.h>

void sys_trace_thread_abort_user(struct k_thread *thread)
{
	/* code */
}

void sys_trace_thread_suspend_user(struct k_thread *thread)
{
	/* code */
}

void sys_trace_thread_resume_user(struct k_thread *thread)
{
	/* code */
}

void sys_trace_thread_name_set_user(struct k_thread *thread)
{
	/* code */
}

void sys_trace_thread_info_user(struct k_thread *thread)
{
	/* code */
}

void sys_trace_thread_sched_ready_user(struct k_thread *thread)
{
	/* code */
}

void sys_trace_thread_pend_user(struct k_thread *thread)
{
	/* code */
}

void sys_trace_thread_priority_set_user(struct k_thread *thread, int prio)
{
	/* code */
}

void sys_trace_thread_create_user(struct k_thread *thread)
{
	/* code */
}
```

## src/SysPerfTask.c
```c
/**
 * @file   NrfPerfTask.c
 * @brief  Contain main implementation for NrfPerfTask.
 * @author nullsych
 * @date   May 7, 2024
 * The code inside NrfPerfTask consist of the main measuring routine from nrf_perf.
 *
 */

#include <zephyr/kernel.h>
#include <nrf_perf.h>

#include "common/TasksApi.h"
#include "common/TasksCfg.h"

#include <zephyr/logging/log.h>
LOG_MODULE_REGISTER(NrfPerfTask, LOG_LEVEL_DBG);

TASK_LOCAL TASK_ENTRY_POINT void task_nrf_perf_entry(void)
{
	for (;;) {
		nrf_perf_runtime_overall_statistic();
		k_msleep(NRF_PERF_TASK_PERIOD);
	}
}

/* Define the thread using a macro */
K_THREAD_DEFINE(Task_NrfPerf, NRF_PERF_TASK_STACKSIZE, task_nrf_perf_entry, NULL, NULL, NULL,
		NRF_PERF_TASK_PRIORITY, 0, 0);
```
