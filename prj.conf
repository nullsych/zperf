## CMakeLists.txt
```
if(CONFIG_ZPERF)
    set(ZPERF_INCLUDE_DIRS
        ${CMAKE_CURRENT_SOURCE_DIR}/include
        ${CMAKE_CURRENT_SOURCE_DIR}/wrapper
        ${CMAKE_CURRENT_SOURCE_DIR}/cfg
        ${CMAKE_CURRENT_SOURCE_DIR}/map
    )

    zephyr_library_named(zperf)

    zephyr_library_sources(
        src/zperf.c
        src/zperf_history.c
        src/zperf_clock.c
        wrapper/rtos_wrapper.c
        map/rtos_hooks.c
    )

    zephyr_library_include_directories(
        ${ZPERF_INCLUDE_DIRS}
    )

    zephyr_include_directories(
        ${ZPERF_INCLUDE_DIRS}
    )
endif()
```

## Kconfig
```
menuconfig ZPERF
    bool "zperf runtime analyzer"
    select LOG
    select THREAD_MONITOR
    select THREAD_NAME
    select TRACING
    help
      Enable the zperf runtime analyzer tool and its Zephyr tracing hooks.

# zperf runs from the TRACING_USER hooks. TRACING_USER is a member of a choice, which
# 'select' cannot set, so make it the default tracing format instead. Module Kconfig is
# sourced before subsys/tracing, so this default takes precedence over TRACING_NONE.
choice TRACING_FORMAT_CHOICE
    default TRACING_USER if ZPERF
endchoice

if ZPERF

choice ZPERF_TIMESTAMP_SOURCE
    prompt "Timestamp source"
    default ZPERF_TIMESTAMP_TIMING_FUNCTIONS
    help
      Clock zperf uses to time threads.

config ZPERF_TIMESTAMP_TIMING_FUNCTIONS
    bool "Cycle counter (timing functions)"
    select TIMING_FUNCTIONS
    help
      Use the cycle counter of the Zephyr timing functions (DWT CYCCNT on Cortex-M) for
      microsecond resolution. The counter may stop while the CPU sleeps, so zperf keeps it in
      step with the kernel tick clock: time is measured at counter resolution while the CPU
      runs, and at tick resolution across sleep.

config ZPERF_TIMESTAMP_UPTIME_TICKS
    bool "Kernel uptime ticks"
    help
      Use k_uptime_ticks() only. Resolution is one system tick
      (1 / CONFIG_SYS_CLOCK_TICKS_PER_SEC, about 30.5 us on nRF52).

endchoice

config ZPERF_TRACE_MAIN_STAT
    bool "Trace per-cycle thread runtime statistics"
    default y

config ZPERF_TRACE_UPTIME
    bool "Trace uptime statistics"
    default y

config ZPERF_TRACE_HISTORY
    bool "Trace collected hook history"
    default n

config ZPERF_TRACE_CPU_LOAD
    bool "Trace CPU load statistics"
    default y

config ZPERF_RTOS_HAS_SYSTEM_TASKS
    bool "Account for RTOS-created system threads"
    default y

config ZPERF_USER_TASKS_COUNT
    int "Number of application threads"
    default 3
    range 0 255

config ZPERF_SYSTEM_TASKS_COUNT
    int "Number of RTOS/system threads"
    default 5
    range 0 255
    depends on ZPERF_RTOS_HAS_SYSTEM_TASKS

config ZPERF_ISR_RUNTIME_SUPPORTED
    bool "Enable ISR runtime accounting"
    default y

config ZPERF_ISR_RUNTIME_DISTINGUISH
    bool "Distinguish individual ISRs"
    default n

config ZPERF_ISR_TOTAL_RUNTIME_ONLY
    bool "Measure total ISR runtime only"
    default y

config ZPERF_RTOS_HAS_IDLE_SWITCHES
    bool "RTOS exposes idle enter/exit switches"
    default n

config ZPERF_HISTORY_SIZE
    int "Hook history size"
    default 25
    range 1 1024

config ZPERF_CPU_USAGE_THRESHOLD
    int "CPU usage warning threshold"
    default 50
    range 0 100

endif
```

## prj.conf
```kconfig
# Enable to use GPIO
CONFIG_GPIO=y

# Enable to use Power Management
CONFIG_PM=y
CONFIG_PM_STATS=y
CONFIG_PM_POLICY_CUSTOM=y
# CONFIG_PM_POLICY_CUSTOM=y

# TODO: add SysPerf library support via cfg
# CONFIG_SYSPERF_LIB=y

# Enable to use STDOUT
CONFIG_STDOUT_CONSOLE=y

# Enable to use thread names
CONFIG_THREAD_NAME=y
CONFIG_SCHED_CPU_MASK=y

# Enable to use thread analyzer
# CONFIG_THREAD_ANALYZER=y
# CONFIG_THREAD_ANALYZER_USE_PRINTK=y
# CONFIG_THREAD_ANALYZER_AUTO=y

# Enable to use SEGGER SystemView
CONFIG_SEGGER_SYSTEMVIEW=y
CONFIG_USE_SEGGER_RTT=y

# Enable for post-mortem tracing
CONFIG_SEGGER_SYSVIEW_POST_MORTEM_MODE=n

# Enable trace-hooks
CONFIG_TRACING=y
CONFIG_TRACING_USER=y

# Enable to use get system uptime in system ticks
# CONFIG_SYS_CLOCK_TICKS_PER_SEC=

# Enable to use custom data in threads
CONFIG_THREAD_CUSTOM_DATA=y
# Enable iterate over all the threads in the system
CONFIG_THREAD_MONITOR=y

# Enable to use logging (logging/log.h)
CONFIG_LOG=y
CONFIG_LOG_BUFFER_SIZE=10240

# Enable to use BLE
CONFIG_BT=y
CONFIG_BT_SMP=y
CONFIG_BT_PERIPHERAL=y
CONFIG_BT_DEVICE_NAME="Nrf SysPerf"
CONFIG_BT_DIS=y
CONFIG_BT_DIS_PNP=n
CONFIG_BT_BAS=y
CONFIG_BT_HRS=y
CONFIG_BT_DEVICE_APPEARANCE=833
```

## src/main.c
```c
/**
 * @file   main.c
 * @brief  Contain implementation of main function.
 * @author kvant6ubl
 * @date   May 7, 2024
 *
 */

#include <stdio.h>
#include <zephyr/kernel.h>

/* Application headers */
#include "common/Leds/Leds.h"
#include "common/TasksCfg.h"
#include "common/TasksApi.h"

/* SysPerf's hooks, used under Zephyr's hooks */
#include <RTOS_Hooks.h>

/* SysPerf's global API */
#include <SysPerf.h>

/* Rest of Zephyr hooks */
#include "RTOSHooks.h"

/* Power Management */
#include "PwrMgt/PwrMgt.h"

#include <zephyr/logging/log.h>
LOG_MODULE_REGISTER(main, LOG_LEVEL_DBG);

int main(void)
{
	LOG_INF("Perform pre-scheduler initializations for SysPerf");
	SysPerf_PreSchedulerInit();

	PwrMgt_init();
	PwrMgt_traceResetReason();

	LOG_INF("Perform post-scheduler initializations for SysPerf");
	SysPerf_PostSchedulerInit();
}

/* EOF */
```

## include/nrf_perf.h
```c
/**
 * @file   nrf_perf.h
 * @brief  Contain main declarations of nrf_perf.
 * @author nullsych
 * @date   May 6, 2024
 *
 */

#ifndef NRF_PERF_H
#define NRF_PERF_H

#include "rtos_map.h"
#include "nrf_perf_data_types.h"
#include "nrf_perf_constants.h"
#include "nrf_perf_keywords.h"

/*******************************************************************************************************************
 *                                                   MACROS                                                         *
 *******************************************************************************************************************/
#define NP_ISR_LOCK   MAP_RTOS_ISR_LOCK
#define NP_ISR_UNLOCK MAP_RTOS_ISR_UNLOCK

#define NP_TRACE_INFO MAP_RTOS_TRACE_INFO
#define NP_TRACE_WARN MAP_RTOS_TRACE_WARN
#define NP_TRACE_ERRO MAP_RTOS_TRACE_ERRO

#define NP_ISR_ID_SIGN (0xFFFC) /* Common ISR signature */

#define TASK_IS_VALID(task_iterator)          ((task_iterator < NP_TASK_COUNT) && (task_iterator >= 0))
#define GET_CPU_PERCENT(time_slice, total_rt) ((total_rt * 100U) / time_slice)

/*******************************************************************************************************************
 *                                            nrf_perf GLOBAL API                                                    *
 *******************************************************************************************************************/
/* Hooks Declarations for RTOS-only usage */
NP_RTOS_CALLED void nrf_perf_pre_task_hook(void);
NP_RTOS_CALLED void nrf_perf_post_task_hook(void);
NP_RTOS_CALLED void nrf_perf_pre_isr_hook(void);
NP_RTOS_CALLED void nrf_perf_post_isr_hook(void);
NP_RTOS_CALLED void nrf_perf_idle_task_running(void);

/* API for user's code */
NP_USER_CALLED extern void nrf_perf_trace_history(void);
NP_USER_CALLED extern void nrf_perf_runtime_overall_statistic(void);
NP_USER_CALLED extern void nrf_perf_pre_scheduler_init(void);
NP_USER_CALLED extern void nrf_perf_post_scheduler_init(void);

#endif /* NRF_PERF_H */
```

## include/nrf_perf_constants.h
```c
/**
 * @file   nrf_perf_Constants.h
 * @brief
 * @author nullsych
 * @date   Nov 19, 2024
 *
 */

#ifndef NRF_PERF_CONSTANTS_H
#define NRF_PERF_CONSTANTS_H

#include "rtos_map.h"

#define NP_TASK_COUNT    MAP_RTOS_OVERALL_TASKS_COUNT /* Overall number of Tasks in the system */
#define NP_IDLE_COUNT    MAP_RTOS_IDLE_TASK_COUNT     /* Total number of Idle Tasks            */
#define NP_TASK_NAME_LEN MAP_RTOS_TASK_MAX_NAME_LEN   /* Maximum length for Task's name        */
#define NP_TIMESTAMP_TOP MAP_RTOS_UPTIME_TOP
#define NP_UNINIT        (0x0E)

#endif /* NRF_PERF_CONSTANTS_H */
```

## include/nrf_perf_data_types.h
```c
/**
 * @file   nrf_perf_data_types.h
 * @brief
 * @author nullsych
 * @date   Jule 9, 2024
 *
 */

#ifndef NRF_PERF_DATA_TYPES_H
#define NRF_PERF_DATA_TYPES_H

#include "rtos_map.h"
#include "nrf_perf_constants.h"
#include "nrf_perf_keywords.h"

/* clang-format off */

typedef MAP_RTOS_PTR2TASK  np_task_ptr;
typedef MAP_RTOS_PRIO      np_task_prio;
typedef MAP_RTOS_STACKSIZE np_task_stack_size;
typedef MAP_RTOS_UNIQ_ID   np_task_id;
typedef MAP_RTOS_UNIQ_ID   np_isr_id;

/* Runtime Unit's (Task's/ISR's) state mask */
typedef enum
{
    /* Written when new Task (Thread) take precedence and start works */
    TASK_STATE_ENTER        = 0x00,

    /* Written when current Task (Thread) finished it work, and new one Task takes precedence */
    TASK_STATE_EXIT         = 0x01,

    /* Written when new ISR take precedence and start works */
    ISR_STATE_ENTER         = 0x02,

    /* Written when current ISR finished it work, and new one Task/ISR takes precedence */
    ISR_STATE_EXIT          = 0x03,

    /* Written when Idle Tasks (Thread) is running */
    IDLE_STATE_RUNNING      = 0x04

} np_runtime_state_mask;
/* clang-format on */

/* Hook statistic */
typedef struct NP_PACKED {
	uint32_t timestamp;
	uint32_t identifier;
	uint8_t state;
} np_hook;

/* Task (Thread) runtime information */
typedef struct NP_PACKED {
	uint32_t task_timestamp;
	uint32_t total_runtime;
	uint32_t max_runtime;
	uint32_t task_switches;
} np_task_runtime;

/* Runtime information of a ISR */
typedef struct NP_PACKED {
	uint32_t isr_timestamp;
	uint32_t total_runtime;
	uint32_t max_runtime;
	uint32_t isr_switches;
} np_isr_runtime;

/* Total system uptime statistic */
typedef struct NP_PACKED {
	uint32_t tasks_runtime[NP_TASK_COUNT];
	uint32_t tasks_switches[NP_TASK_COUNT];
	uint32_t max_tasks_runtime[NP_TASK_COUNT];
	uint32_t isr_runtime[NP_TASK_COUNT];
	uint32_t idle_runtime;
	uint32_t timestamp;
} np_uptime_statistic_t;

#endif /* NRF_PERF_DATA_TYPES_H */
```

## include/nrf_perf_history.h
```c
/**
 * @file   nrf_perf_history.h
 * @brief
 * @author nullsych
 * @date   May 6, 2024
 *
 */

#ifndef NRF_PERF_HISTORY_H
#define NRF_PERF_HISTORY_H

#include "nrf_perf_keywords.h"
#include "nrf_perf_data_types.h"

/*******************************************************************************************************************
 *                                              HISTORY CONSTANTS                 *
 *******************************************************************************************************************/
#ifdef CONFIG_NRF_PERF_HISTORY_SIZE
#define NP_HISTORY_SIZE (CONFIG_NRF_PERF_HISTORY_SIZE)
#else
#define NP_HISTORY_SIZE (8U)
#endif

#ifdef CONFIG_NRF_PERF_CPU_USAGE_THRESHOLD
#define NP_CPU_USAGE_THR (CONFIG_NRF_PERF_CPU_USAGE_THRESHOLD)
#else
#define NP_CPU_USAGE_THR (50U)
#endif

/* History statistic */
typedef struct NP_PACKED {
	np_hook entities[NP_HISTORY_SIZE];
	uint32_t crc32;
} np_hook_history;

/*******************************************************************************************************************
 *                                            HISTORY GLOBAL API                 *
 ********************************************************************************************************************/

NP_HOOK_CALLED NP_GLOBAL void nrf_perf_history_init(void);
NP_HOOK_CALLED NP_GLOBAL void nrf_perf_history_update(uint32_t, uint32_t, uint8_t);
NP_HOOK_CALLED NP_GLOBAL void nrf_perf_history_clear(void);
NP_HOOK_CALLED NP_GLOBAL void nrf_perf_history_dump_byte_stream(void);
NP_USER_CALLED NP_GLOBAL void nrf_perf_history_trace_collected(void);

NP_HOOK_CALLED NP_GLOBAL uint8_t nrf_perf_history_get_last_state(void);
NP_HOOK_CALLED NP_GLOBAL uint8_t nrf_perf_history_get_last_task(void);
NP_HOOK_CALLED NP_GLOBAL uint32_t nrf_perf_history_get_last_timestamp(void);

#endif /* NRF_PERF_HISTORY_H */
```

## include/nrf_perf_keywords.h
```c
/**
 * @file   nrf_perf_keywords.h
 * @brief
 * @author nullsych
 * @date   Nov 16, 2024
 *
 */

#ifndef NRF_PERF_KEYWORDS_H
#define NRF_PERF_KEYWORDS_H

/* clang-format off */
/*******************************************************************************************************************
 *                                            KEYWORDS                                                             *
 *******************************************************************************************************************/
/* clang-format on */

#define NP_LOCAL         static
#define NP_INLINE        inline
#define NP_GLOBAL        extern
#define NP_LOCAL_INLINE  static inline
#define NP_GLOBAL_INLINE extern inline
#define NP_PACKED        __packed
#define NP_ALIGNED(x)    __aligned(x)

#define NP_RTOS_CALLED  /* Called within RTOS hooks (Pre, Post, Idle, Shutdown etc.)     */
#define NP_USER_CALLED  /* Called within user application code                           */
#define NP_HOOK_CALLED  /* Called within nrf_perf's calculation logic                     */
#define NP_RTOS_WRAPPER /* Called within RTOS API (e.g. callbacks)                       */

#endif /* NRF_PERF_KEYWORDS_H */
```

## include/nrf_perf_rtos_wrapper.h
```c
/**
 * @file   nrf_perf_rtos_wrapper.h
 * @brief  Declaration of external wrappers API.
 * @author nullsych
 * @date   Jul 18, 2024
 *
 */

#ifndef NRF_PERF_RTOS_WRAPPER_H
#define NRF_PERF_RTOS_WRAPPER_H

/* clang-format off */
/*******************************************************************************************************************
 *                                                STD HEADERS                                                      *
 *******************************************************************************************************************/
#include <stdint.h>

/*******************************************************************************************************************
 *                                                  HEADERS                                                        *
 *******************************************************************************************************************/
#include "nrf_perf_keywords.h"

/*******************************************************************************************************************
 *                                        GLOBAL API DECLARATION                                                    *
 *******************************************************************************************************************/
/* clang-format on */

extern NP_RTOS_WRAPPER uint32_t nrf_perf_get_task_id(void);
extern NP_RTOS_WRAPPER void nrf_perf_init_configuration(void);
extern NP_RTOS_WRAPPER uint8_t nrf_perf_get_task_iterator(uint32_t);
extern NP_RTOS_WRAPPER const char *nrf_perf_get_task_name(uint32_t);
extern NP_RTOS_WRAPPER uint32_t nrf_perf_get_uptime_timestamp(void);

#endif /* NRF_PERF_RTOS_WRAPPER_H */
```

## include/zperf.h
```c
/**
 * @file   zperf.h
 * @brief  Public API for user code.
 * @author nullsych
 * @date   May 6, 2024
 *
 */

#ifndef ZPERF_H
#define ZPERF_H

#include "zperf_keywords.h"

/* API for user's code */
ZP_USER_CALLED extern void zperf_trace_history(void);
ZP_USER_CALLED extern void zperf_runtime_overall_statistic(void);
ZP_USER_CALLED extern void zperf_pre_scheduler_init(void);
ZP_USER_CALLED extern void zperf_post_scheduler_init(void);

#endif /* ZPERF_H */
```

## include/zperf_clock.h
```c
/**
 * @file   zperf_clock.h
 * @brief  Microsecond uptime from a cycle counter, kept in step with the RTOS tick clock.
 *
 * A free-running cycle counter (e.g. DWT CYCCNT on Cortex-M) gives sub-tick resolution, but it
 * may stop while the CPU sleeps and it wraps quickly (about every 67 s at 64 MHz). This clock
 * advances by the cycles counted since its previous update, and is then held within the
 * current tick of the RTOS tick clock:
 *
 *   - it never falls behind the tick clock: after sleep, or a counter wrap that was missed, it
 *     catches up to the start of the current tick;
 *   - it never runs a full tick ahead of it, which bounds drift between the two oscillators.
 *
 * So time is measured at counter resolution while the CPU runs, and at tick resolution across
 * sleep. The returned value is monotonic (modulo 2^32 us) as long as the tick clock is.
 *
 * The code is RTOS-agnostic: the RTOS wrapper reads the counter and the tick clock.
 */

#ifndef ZPERF_CLOCK_H
#define ZPERF_CLOCK_H

#include <stdint.h>

typedef struct {
	uint32_t now_us;        /* Last returned uptime */
	uint32_t tick_len_us;   /* Length of one tick, rounded up */
	uint32_t cycles_per_us; /* Counter rate if it is a whole number of MHz, otherwise 0 */
	uint64_t freq_hz;       /* Counter rate, used when cycles_per_us is 0 */
	uint64_t rem;           /* Counted but not yet converted: cycles, or cycles * 1e6 */
} zp_clock;

/**
 * @param freq_hz     Counter rate in Hz
 * @param tick_len_us Length of one RTOS tick in microseconds, rounded up
 * @param tick_us     Current tick clock time in microseconds, the clock starts here
 */
void zp_clock_init(zp_clock *clock, uint64_t freq_hz, uint32_t tick_len_us, uint32_t tick_us);

/**
 * @brief Advance the clock and return the current uptime in microseconds.
 *
 * @param delta_cycles Counter cycles since the previous update
 * @param tick_us      Current tick clock time in microseconds (start of the current tick)
 */
uint32_t zp_clock_update(zp_clock *clock, uint64_t delta_cycles, uint32_t tick_us);

#endif /* ZPERF_CLOCK_H */
```

## include/zperf_constants.h
```c
/**
 * @file   zperf_constants.h
 * @brief
 * @author nullsych
 * @date   Nov 19, 2024
 *
 */

#ifndef ZPERF_CONSTANTS_H
#define ZPERF_CONSTANTS_H

#include "rtos_map.h"

#define ZP_TASK_COUNT    MAP_RTOS_OVERALL_TASKS_COUNT /* Overall number of Tasks in the system */
#define ZP_IDLE_COUNT    MAP_RTOS_IDLE_TASK_COUNT     /* Total number of Idle Tasks            */
#define ZP_TASK_NAME_LEN MAP_RTOS_TASK_MAX_NAME_LEN   /* Maximum length for Task's name        */
#define ZP_TIMESTAMP_TOP MAP_RTOS_UPTIME_TOP
/* Marks an unset task iterator. Must stay outside of the valid range [0, ZP_TASK_COUNT) */
#define ZP_UNINIT        (0xFFU)

/* Task iterators are uint8_t and 0xFF is reserved for ZP_UNINIT */
_Static_assert(ZP_TASK_COUNT < ZP_UNINIT,
	       "zperf supports up to 254 tasks: reduce ZPERF_USER/SYSTEM_TASKS_COUNT");

#endif /* ZPERF_CONSTANTS_H */
```

## include/zperf_data_types.h
```c
/**
 * @file   zperf_data_types.h
 * @brief
 * @author nullsych
 * @date   Jule 9, 2024
 *
 */

#ifndef ZPERF_DATA_TYPES_H
#define ZPERF_DATA_TYPES_H

#include "rtos_map.h"
#include "zperf_constants.h"
#include "zperf_keywords.h"

/* clang-format off */

typedef MAP_RTOS_PTR2TASK  zp_task_ptr;
typedef MAP_RTOS_PRIO      zp_task_prio;
typedef MAP_RTOS_STACKSIZE zp_task_stack_size;
typedef MAP_RTOS_UNIQ_ID   zp_task_id;
typedef MAP_RTOS_UNIQ_ID   zp_isr_id;

/* Runtime Unit's (Task's/ISR's) state mask */
typedef enum
{
    /* Written when new Task (Thread) take precedence and start works */
    TASK_STATE_ENTER        = 0x00,

    /* Written when current Task (Thread) finished it work, and new one Task takes precedence */
    TASK_STATE_EXIT         = 0x01,

    /* Written when new ISR take precedence and start works */
    ISR_STATE_ENTER         = 0x02,

    /* Written when current ISR finished it work, and new one Task/ISR takes precedence */
    ISR_STATE_EXIT          = 0x03,

    /* Written when Idle Tasks (Thread) is running */
    IDLE_STATE_RUNNING      = 0x04,

    /* Returned by history getters when no event has been recorded yet */
    HISTORY_STATE_NONE      = 0xFF

} zp_runtime_state_mask;
/* clang-format on */

/* Hook statistic */
typedef struct ZP_PACKED {
	uint32_t timestamp;
	zp_task_id task_id;
	uint8_t state;
} zp_hook;

/* Task (Thread) runtime information */
typedef struct ZP_PACKED {
	uint32_t task_timestamp;
	uint32_t total_runtime;
	uint32_t max_runtime;
	uint32_t task_switches;
} zp_task_runtime;

/* Runtime information of a ISR */
typedef struct ZP_PACKED {
	uint32_t isr_timestamp;
	uint32_t total_runtime;
	uint32_t max_runtime;
	uint32_t isr_switches;
} zp_isr_runtime;

/* Total system uptime statistic */
typedef struct ZP_PACKED {
	uint32_t tasks_runtime[ZP_TASK_COUNT];
	uint32_t tasks_switches[ZP_TASK_COUNT];
	uint32_t max_tasks_runtime[ZP_TASK_COUNT];
	uint32_t isr_runtime[ZP_TASK_COUNT];
	uint32_t idle_runtime;
	uint32_t timestamp;
} zp_uptime_statistic_t;

#endif /* ZPERF_DATA_TYPES_H */
```

## include/zperf_history.h
```c
/**
 * @file   zperf_history.h
 * @brief
 * @author nullsych
 * @date   May 6, 2024
 *
 */

#ifndef ZPERF_HISTORY_H
#define ZPERF_HISTORY_H

#include <stdbool.h>

#include "zperf_keywords.h"
#include "zperf_data_types.h"

/*******************************************************************************************************************
 *                                              HISTORY CONSTANTS
 *******************************************************************************************************************/
#ifdef CONFIG_ZPERF_HISTORY_SIZE
#define ZP_HISTORY_SIZE (CONFIG_ZPERF_HISTORY_SIZE)
#else
#define ZP_HISTORY_SIZE (25U)
#endif

#ifdef CONFIG_ZPERF_CPU_USAGE_THRESHOLD
#define ZP_CPU_USAGE_THR (CONFIG_ZPERF_CPU_USAGE_THRESHOLD)
#else
#define ZP_CPU_USAGE_THR (50U)
#endif

/* History statistic */
typedef struct ZP_PACKED {
	zp_hook entities[ZP_HISTORY_SIZE];
	uint32_t crc32;
} zp_hook_history;

/*******************************************************************************************************************
 *                                            HISTORY GLOBAL API
 ********************************************************************************************************************/

ZP_HOOK_CALLED ZP_GLOBAL void history_init(void);
ZP_HOOK_CALLED ZP_GLOBAL void history_update(zp_task_id, uint32_t, uint8_t);
ZP_HOOK_CALLED ZP_GLOBAL void history_clear(void);
ZP_HOOK_CALLED ZP_GLOBAL void history_dump_byte_stream(void);
ZP_USER_CALLED ZP_GLOBAL void history_trace_collected(void);
ZP_HOOK_CALLED ZP_GLOBAL void history_snapshot_take(bool clear);
ZP_USER_CALLED ZP_GLOBAL void history_trace_snapshot(void);

ZP_HOOK_CALLED ZP_GLOBAL uint8_t history_get_last_state(void);
ZP_HOOK_CALLED ZP_GLOBAL zp_task_id history_get_last_task(void);
ZP_HOOK_CALLED ZP_GLOBAL uint32_t history_get_last_timestamp(void);

#endif /* ZPERF_HISTORY_H */
```

## include/zperf_internal.h
```c
/**
 * @file   zperf_internal.h
 * @brief  Internal macros and RTOS hook declarations (not for user code).
 * @author nullsych
 * @date   May 6, 2024
 *
 */

#ifndef ZPERF_INTERNAL_H
#define ZPERF_INTERNAL_H

#include "zperf.h"
#include "rtos_map.h"
#include "zperf_data_types.h"
#include "zperf_constants.h"

/*******************************************************************************************************************
 *                                                   MACROS
 *******************************************************************************************************************/
#define ZP_ISR_LOCK   MAP_RTOS_ISR_LOCK
#define ZP_ISR_UNLOCK MAP_RTOS_ISR_UNLOCK

#define ZP_TRACE_INFO MAP_RTOS_TRACE_INFO
#define ZP_TRACE_WARN MAP_RTOS_TRACE_WARN
#define ZP_TRACE_ERRO MAP_RTOS_TRACE_ERRO

#define ZP_ISR_ID_SIGN (0xFFFC) /* Common ISR signature */

#define TASK_IS_VALID(task_iterator) ((task_iterator < ZP_TASK_COUNT) && (task_iterator >= 0))
/* 64-bit math: total_rt * 100 overflows uint32_t for windows longer than ~43 s */
#define GET_CPU_PERCENT(time_slice, total_rt)                                                      \
	(((time_slice) == 0U) ? 0U                                                                 \
			      : (uint32_t)(((uint64_t)(total_rt) * 100U) / (uint64_t)(time_slice)))

/*******************************************************************************************************************
 *                                            RTOS HOOKS
 *******************************************************************************************************************/
ZP_RTOS_CALLED void pre_task_hook(void);
ZP_RTOS_CALLED void post_task_hook(void);
ZP_RTOS_CALLED void pre_isr_hook(void);
ZP_RTOS_CALLED void post_isr_hook(void);
ZP_RTOS_CALLED void idle_task_running(void);

/* Called by the RTOS wrapper while enumerating threads, with IRQs locked */
ZP_RTOS_CALLED uint8_t zperf_task_register(zp_task_id task_id);

#endif /* ZPERF_INTERNAL_H */
```
