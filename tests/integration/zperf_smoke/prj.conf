## CMakeLists.txt
```
# SPDX-License-Identifier: Apache-2.0

cmake_minimum_required(VERSION 3.20.0)

# zperf is the module under test. In CI it is also the west manifest repository; Zephyr merges
# both entries since they have the same module name.
list(APPEND ZEPHYR_EXTRA_MODULES "${CMAKE_CURRENT_LIST_DIR}/../../..")

find_package(Zephyr REQUIRED HINTS $ENV{ZEPHYR_BASE})
project(zperf_smoke)

target_sources(app PRIVATE src/main.c)
```

## prj.conf
```kconfig
# zperf with its defaults. CONFIG_TRACING_USER is left out on purpose: the zperf Kconfig must
# make it the default tracing format, otherwise the build stops with #error.
CONFIG_ZPERF=y
CONFIG_ZPERF_TRACE_HISTORY=y
CONFIG_ZPERF_HISTORY_SIZE=64

# main, idle, logging, sysworkq, busy_worker, zperf_report, plus headroom
CONFIG_ZPERF_USER_TASKS_COUNT=3
CONFIG_ZPERF_SYSTEM_TASKS_COUNT=4

CONFIG_LOG=y
CONFIG_LOG_BUFFER_SIZE=16384

# The default timestamp source is the cycle counter (timing functions). native_sim keeps its
# default 10 ms tick, so the worker's 2 ms busy periods are only visible thanks to it.
```

## src/main.c
```c
/*
 * SPDX-License-Identifier: Apache-2.0
 *
 * zperf on a real Zephyr kernel. A worker keeps the CPU partly busy and zperf prints a window
 * every second; twister checks the console output (see testcase.yaml): the startup thread
 * list, the CPU load line and history rows for the idle and worker threads.
 */

#include <zephyr/kernel.h>
#include <zperf.h>

#define BUSY_WORKER_BUSY_US    2000
#define BUSY_WORKER_PERIOD_MS  10
#define ZPERF_REPORT_PERIOD_MS 1000

static void busy_worker_entry(void *p1, void *p2, void *p3)
{
	int64_t next_ms = k_uptime_get();

	ARG_UNUSED(p1);
	ARG_UNUSED(p2);
	ARG_UNUSED(p3);

	/* Absolute wake-ups keep the period at 10 ms whatever the tick rate: a relative
	 * k_msleep() would round up to ticks and stretch the period with 10 ms ticks.
	 */
	for (;;) {
		k_busy_wait(BUSY_WORKER_BUSY_US);
		next_ms += BUSY_WORKER_PERIOD_MS;
		k_sleep(K_TIMEOUT_ABS_MS(next_ms));
	}
}

static void zperf_report_entry(void *p1, void *p2, void *p3)
{
	ARG_UNUSED(p1);
	ARG_UNUSED(p2);
	ARG_UNUSED(p3);

	for (;;) {
		k_msleep(ZPERF_REPORT_PERIOD_MS);
		zperf_runtime_overall_statistic();
	}
}

/* Both start after main() returns or blocks: main runs at a higher priority */
K_THREAD_DEFINE(busy_worker, 1024, busy_worker_entry, NULL, NULL, NULL, 7, 0, 0);
K_THREAD_DEFINE(zperf_report, 2048, zperf_report_entry, NULL, NULL, NULL, 5, 0, 0);

int main(void)
{
	zperf_pre_scheduler_init();
	zperf_post_scheduler_init();
	return 0;
}
```
